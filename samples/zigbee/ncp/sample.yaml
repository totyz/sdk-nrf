## samples/zigbee/ncp/sample.yaml
```yaml
sample:
  name: Zigbee NCP
  description: Zigbee network co-processor

tests:
  zigbee.ncp:
    build_only: true
    platform_allow: nrf52833dk_nrf52833 nrf52840dk_nrf52840 nrf21540dk_nrf52840
    tags: ci_build
    integration_platforms:
      - nrf52840dk_nrf52840
      - nrf52833dk_nrf52833
      - nrf21540dk_nrf52840

  zigbee.ncp.usb:
    build_only: true
    platform_allow: nrf52833dk_nrf52833 nrf52840dk_nrf52840 nrf52840dongle_nrf52840 nrf21540dk_nrf52840
    tags: ci_build
    extra_args: CONF_FILE=prj_usb.conf CONFIG_ZBOSS_TRACE_BINARY_LOGGING=y CONFIG_ZBOSS_TRACE_MASK=0x100800 CONFIG_ZBOSS_TRACE_LOG_LEVEL_DBG=y CONFIG_ZBOSS_TRACE_UART_LOGGING=y CONFIG_ZB_TRACE_MASK=0x100800 CONFIG_ZB_LOG_LEVEL_DBG=y
    integration_platforms:
      - nrf52840dk_nrf52840
      - nrf52833dk_nrf52833
      - nrf21540dk_nrf52840
      - nrf52840dongle_nrf52840

  zigbee.ncp.with_nrf21540ek:
    build_only: true
    platform_allow: nrf52840dk_nrf52840
    tags: ci_build
    extra_args: SHIELD=nrf21540_ek
    integration_platforms:
      - nrf52840dk_nrf52840
```
